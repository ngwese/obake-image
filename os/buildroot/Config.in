## os/buildroot/Config.in
```kconfig
menu "obake host configuration"

source "$BR2_EXTERNAL_OBAKE_PATH/package/obake-host-config/Config.in"
source "$BR2_EXTERNAL_OBAKE_PATH/package/obake-container/Config.in"
source "$BR2_EXTERNAL_OBAKE_PATH/package/obake-pipewire/Config.in"
source "$BR2_EXTERNAL_OBAKE_PATH/package/obake-wireplumber/Config.in"
source "$BR2_EXTERNAL_OBAKE_PATH/package/obake-runtime/Config.in"
source "$BR2_EXTERNAL_OBAKE_PATH/package/singularity/Config.in"
source "$BR2_EXTERNAL_OBAKE_PATH/package/r8125/Config.in"

endmenu
```

## os/buildroot/configs/obake_aarch64_defconfig
```kconfig
BR2_aarch64=y
BR2_PACKAGE_HOST_LINUX_HEADERS_CUSTOM_6_19=y
BR2_DOWNLOAD_FORCE_CHECK_HASHES=y
BR2_GLOBAL_PATCH_DIR="$(BR2_EXTERNAL_OBAKE_PATH)/board/obake/patches"
BR2_TOOLCHAIN_BUILDROOT_CXX=y
BR2_ROOTFS_POST_BUILD_SCRIPT="$(BR2_EXTERNAL_OBAKE_PATH)/board/obake/post-build.sh"
BR2_ROOTFS_POST_IMAGE_SCRIPT="$(BR2_EXTERNAL_OBAKE_PATH)/board/obake/post-image.sh"
BR2_ROOTFS_OVERLAY="$(BR2_EXTERNAL_OBAKE_PATH)/board/obake/rootfs-overlay"
BR2_ROOTFS_USERS_TABLES="$(BR2_EXTERNAL_OBAKE_PATH)/board/obake/users.txt"
BR2_INIT_SYSTEMD=y
BR2_PACKAGE_SYSTEMD_LOGIND=y
BR2_PACKAGE_SYSTEMD_NETWORKD=y
BR2_PACKAGE_SYSTEMD_RESOLVED=y
BR2_PACKAGE_DBUS=y
BR2_PACKAGE_SYSTEMD_POLKIT=y
BR2_PACKAGE_OPENSSH=y
BR2_PACKAGE_BASH=y
BR2_PACKAGE_GREP=y
BR2_PACKAGE_VIM=y
BR2_PACKAGE_RAUC=y
BR2_PACKAGE_GPTFDISK=y
BR2_PACKAGE_GPTFDISK_SGDISK=y
BR2_PACKAGE_DOSFSTOOLS=y
BR2_PACKAGE_DOSFSTOOLS_MKFS_FAT=y
BR2_PACKAGE_PARTED=y
BR2_PACKAGE_EFIBOOTMGR=y
BR2_PACKAGE_UTIL_LINUX_BINARIES=y
BR2_PACKAGE_UTIL_LINUX_MOUNTPOINT=y
BR2_PACKAGE_OBAKE_HOST_CONFIG=y
BR2_PACKAGE_OBAKE_RUNTIME=y
BR2_LINUX_KERNEL=y
BR2_LINUX_KERNEL_CUSTOM_VERSION=y
BR2_LINUX_KERNEL_CUSTOM_VERSION_VALUE="7.2.9"
BR2_LINUX_KERNEL_USE_CUSTOM_CONFIG=y
BR2_LINUX_KERNEL_CUSTOM_CONFIG_FILE="$(BR2_EXTERNAL_OBAKE_PATH)/board/obake/qemu-aarch64/linux.config"
BR2_LINUX_KERNEL_CONFIG_FRAGMENT_FILES="$(BR2_EXTERNAL_OBAKE_PATH)/board/obake/linux-realtime.fragment"
BR2_LINUX_KERNEL_NEEDS_HOST_OPENSSL=y
BR2_TARGET_ROOTFS_EXT2=y
BR2_TARGET_ROOTFS_EXT2_4=y
BR2_TARGET_ROOTFS_EXT2_SIZE="1G"
BR2_TARGET_ROOTFS_TAR=y
BR2_PRIMARY_SITE="https://sources.buildroot.net"
```

## os/buildroot/configs/obake_x86_64_defconfig
```kconfig
BR2_x86_64=y
BR2_PACKAGE_HOST_LINUX_HEADERS_CUSTOM_6_19=y
BR2_DOWNLOAD_FORCE_CHECK_HASHES=y
BR2_ROOTFS_POST_BUILD_SCRIPT="$(BR2_EXTERNAL_OBAKE_PATH)/board/obake/post-build.sh"
BR2_ROOTFS_OVERLAY="$(BR2_EXTERNAL_OBAKE_PATH)/board/obake/rootfs-overlay"
BR2_ROOTFS_USERS_TABLES="$(BR2_EXTERNAL_OBAKE_PATH)/board/obake/users.txt"
BR2_INIT_SYSTEMD=y
BR2_PACKAGE_SYSTEMD_LOGIND=y
BR2_PACKAGE_SYSTEMD_NETWORKD=y
BR2_PACKAGE_SYSTEMD_RESOLVED=y
BR2_PACKAGE_DBUS=y
BR2_PACKAGE_SYSTEMD_POLKIT=y
BR2_PACKAGE_OPENSSH=y
BR2_PACKAGE_BASH=y
BR2_PACKAGE_GREP=y
BR2_PACKAGE_GIT=y
BR2_PACKAGE_VIM=y
BR2_PACKAGE_SUDO=y
BR2_PACKAGE_IPROUTE2=y
BR2_PACKAGE_ALSA_UTILS=y
BR2_PACKAGE_USB_MODESWITCH=y
BR2_PACKAGE_NFTABLES=y
BR2_PACKAGE_LIBCURL=y
BR2_PACKAGE_AVAHI=y
BR2_PACKAGE_AVAHI_DAEMON=y
BR2_PACKAGE_NSS_MDNS=y
BR2_PACKAGE_OBAKE_HOST_CONFIG=y
BR2_LINUX_KERNEL=y
BR2_LINUX_KERNEL_CUSTOM_VERSION=y
BR2_LINUX_KERNEL_CUSTOM_VERSION_VALUE="7.2.9"
BR2_LINUX_KERNEL_USE_CUSTOM_CONFIG=y
BR2_LINUX_KERNEL_CUSTOM_CONFIG_FILE="$(BR2_EXTERNAL_OBAKE_PATH)/board/obake/qemu-x86_64/linux.config"
BR2_LINUX_KERNEL_CONFIG_FRAGMENT_FILES="$(BR2_EXTERNAL_OBAKE_PATH)/board/obake/linux-realtime.fragment"
BR2_LINUX_KERNEL_NEEDS_HOST_LIBELF=y
BR2_TARGET_ROOTFS_EXT2=y
BR2_TARGET_ROOTFS_EXT2_4=y
BR2_TARGET_ROOTFS_EXT2_SIZE="1G"
BR2_TARGET_ROOTFS_TAR=y
BR2_PRIMARY_SITE="https://sources.buildroot.net"
```

## os/buildroot/package/obake-container/Config.in
```kconfig
config BR2_PACKAGE_OBAKE_CONTAINER
	bool "obake container runtime layer"
	select BR2_PACKAGE_SINGULARITY
	help
	  The obake container runtime layer: the SingularityCE runtime that
	  the shapes execute as SIF images, together with its (considerable)
	  dependency set. This keeps the container runtime a single named
	  meta-package, separate from the audio/network runtime that
	  obake-runtime selects.

	  Future changes add further meta-packages (developer tooling,
	  audio-over-IP) the same way.
```

## os/buildroot/package/obake-host-config/Config.in
```kconfig
config BR2_PACKAGE_OBAKE_HOST_CONFIG
	bool "obake host config"
	help
	  Install the obake host-level udev rules and the PipeWire and
	  WirePlumber factory configuration kept under image/host.
```

## os/buildroot/package/obake-jack2/Config.in
```kconfig
config BR2_PACKAGE_OBAKE_JACK2
	bool "obake jack2 (jackd + jackdbus, no Python)"
	depends on BR2_TOOLCHAIN_HAS_THREADS # alsa-lib, dbus
	depends on BR2_USE_MMU # fork()
	depends on BR2_INSTALL_LIBSTDCPP
	depends on !BR2_STATIC_LIBS
	depends on BR2_TOOLCHAIN_HAS_SYNC_4
	depends on BR2_USE_WCHAR # dbus
	select BR2_PACKAGE_ALSA_LIB
	select BR2_PACKAGE_ALSA_LIB_HWDEP
	select BR2_PACKAGE_ALSA_LIB_SEQ
	select BR2_PACKAGE_ALSA_LIB_RAWMIDI
	select BR2_PACKAGE_DBUS
	select BR2_PACKAGE_EXPAT
	help
	  jack2 built with the classic server (jackd) and D-Bus support
	  (jackdbus). The Python jack_control helper is removed and no Python
	  runtime is selected; drive jackdbus over its D-Bus interface.

	  Use this instead of the in-tree jack2 when the D-Bus control
	  interface is wanted but the Python CLI is not.
```

## os/buildroot/package/obake-pipewire/Config.in
```kconfig
config BR2_PACKAGE_OBAKE_PIPEWIRE
	bool "obake pipewire"
	depends on BR2_TOOLCHAIN_HAS_THREADS # alsa-lib, dbus
	depends on BR2_USE_MMU # fork()
	depends on !BR2_STATIC_LIBS
	depends on BR2_TOOLCHAIN_HAS_SYNC_4
	depends on BR2_USE_WCHAR # dbus
	depends on BR2_PACKAGE_SYSTEMD
	select BR2_PACKAGE_ALSA_LIB
	select BR2_PACKAGE_ALSA_LIB_HWDEP
	select BR2_PACKAGE_ALSA_LIB_SEQ
	select BR2_PACKAGE_ALSA_LIB_UCM
	select BR2_PACKAGE_DBUS
	select BR2_PACKAGE_LIBSNDFILE
	select BR2_PACKAGE_NCURSES
	select BR2_PACKAGE_NCURSES_WCHAR # pw-top
	select BR2_PACKAGE_READLINE # pw-cli
	help
	  PipeWire 1.6.9 for the obake host: the daemon, the ALSA plugin,
	  and pipewire-jack. The plugin that makes PipeWire a client of
	  jackd, and PulseAudio support, are disabled. No Python runtime
	  is selected.

	  https://pipewire.org/

comment "obake pipewire needs systemd and a toolchain w/ wchar, threads, dynamic library"
	depends on BR2_USE_MMU
	depends on !BR2_PACKAGE_SYSTEMD || !BR2_USE_WCHAR || \
		!BR2_TOOLCHAIN_HAS_THREADS || BR2_STATIC_LIBS || \
		!BR2_TOOLCHAIN_HAS_SYNC_4
```

## os/buildroot/package/obake-ravenna/Config.in
```kconfig
# SPDX-FileCopyrightText: Copyright 2026 Greg Wuller
# SPDX-License-Identifier: MIT

config BR2_PACKAGE_OBAKE_RAVENNA
	bool "obake-ravenna"
	depends on BR2_PACKAGE_OBAKE_PIPEWIRE
	depends on BR2_PACKAGE_SYSTEMD
	select BR2_PACKAGE_HOST_RUSTC
	help
	  RAVENNA session daemon for the obake PipeWire graph. Selected
	  only on the qdl board. Browses and publishes RAVENNA RTSP
	  services, serves SDP, and loads PipeWire RTP modules while
	  ptp4l reports a lock.

comment "obake-ravenna needs obake-pipewire and systemd"
	depends on !BR2_PACKAGE_OBAKE_PIPEWIRE || !BR2_PACKAGE_SYSTEMD
```

## os/buildroot/package/obake-runtime/Config.in
```kconfig
config BR2_PACKAGE_OBAKE_RUNTIME
	bool "obake runtime layer"
	select BR2_PACKAGE_ALSA_UTILS
	select BR2_PACKAGE_JACK2
	select BR2_PACKAGE_USB_MODESWITCH
	select BR2_PACKAGE_NFTABLES
	select BR2_PACKAGE_AVAHI
	select BR2_PACKAGE_AVAHI_DAEMON
	select BR2_PACKAGE_NSS_MDNS
	select BR2_PACKAGE_LIBCURL
	select BR2_PACKAGE_LIBCURL_CURL
	select BR2_PACKAGE_IPROUTE2
	select BR2_PACKAGE_SUDO
	select BR2_PACKAGE_GIT
	help
	  The obake shapes runtime layer: the audio and networking runtime plus
	  the container runtime that shapes build and run on. This meta-package
	  selects its member packages so a defconfig names the layer once.
	  Additional runtime members (the Singularity container runtime) and
	  further meta-packages (developer tooling, audio-over-IP) are added by
	  later changes.
```

## os/buildroot/package/obake-session/Config.in
```kconfig
# SPDX-FileCopyrightText: Copyright 2026 Greg Wuller
# SPDX-License-Identifier: MIT

config BR2_PACKAGE_OBAKE_SESSION
	bool "obake-session"
	depends on BR2_PACKAGE_OBAKE_PIPEWIRE
	depends on BR2_PACKAGE_SYSTEMD
	select BR2_PACKAGE_HOST_RUSTC
	help
	  Rig and session daemon for the obake host, plus the
	  portable obake GraphQL client. Selected by the runtime layer
	  on every board.

comment "obake-session needs obake-pipewire and systemd"
	depends on !BR2_PACKAGE_OBAKE_PIPEWIRE || !BR2_PACKAGE_SYSTEMD
```

## os/buildroot/package/obake-wireplumber/Config.in
```kconfig
config BR2_PACKAGE_OBAKE_WIREPLUMBER
	bool "obake wireplumber"
	depends on BR2_PACKAGE_OBAKE_PIPEWIRE
	depends on BR2_USE_WCHAR # libglib2
	depends on BR2_TOOLCHAIN_HAS_THREADS # libglib2
	depends on BR2_USE_MMU # libglib2
	select BR2_PACKAGE_LIBGLIB2
	select BR2_PACKAGE_LUA
	help
	  WirePlumber 0.5.18, the session manager for the obake PipeWire
	  graph. Built against the system Lua interpreter. Introspection
	  is disabled, so this package selects neither Python nor
	  gobject-introspection.

	  https://pipewire.pages.freedesktop.org/wireplumber/

comment "obake wireplumber needs obake-pipewire and a toolchain w/ wchar, threads"
	depends on BR2_USE_MMU
	depends on !BR2_PACKAGE_OBAKE_PIPEWIRE || !BR2_USE_WCHAR || \
		!BR2_TOOLCHAIN_HAS_THREADS
```

## os/buildroot/package/r8125/Config.in
```kconfig
config BR2_PACKAGE_R8125
	bool "r8125"
	depends on BR2_LINUX_KERNEL
	help
	  Realtek out-of-tree driver for RTL8125 2.5GbE, built with
	  hardware timestamping for the qdl board.

	  https://www.realtek.com/
```

## os/buildroot/package/singularity/Config.in
```kconfig
config BR2_PACKAGE_SINGULARITY
	bool "singularity-ce"
	depends on BR2_PACKAGE_HOST_GO_TARGET_ARCH_SUPPORTS
	depends on BR2_USE_MMU # go, fork
	depends on BR2_TOOLCHAIN_HAS_THREADS # go
	depends on BR2_USE_WCHAR
	depends on !BR2_STATIC_LIBS
	depends on BR2_TOOLCHAIN_HAS_SYNC_4
	select BR2_PACKAGE_LIBSECCOMP
	select BR2_PACKAGE_LIBGPGME
	select BR2_PACKAGE_CRYPTSETUP
	select BR2_PACKAGE_LIBFUSE3
	select BR2_PACKAGE_OPENSSL
	select BR2_PACKAGE_ZLIB
	select BR2_PACKAGE_LZ4
	select BR2_PACKAGE_XZ
	select BR2_PACKAGE_ZSTD
	select BR2_PACKAGE_LZO
	select BR2_PACKAGE_UTIL_LINUX
	select BR2_PACKAGE_E2FSPROGS
	select BR2_PACKAGE_SQUASHFS
	help
	  SingularityCE container runtime, built from source at a pinned
	  version. This is the runtime the shapes run on.

	  Built with the setuid helper (kernel SquashFS SIF mounts) and
	  without libsubid (local /etc/subuid and /etc/subgid only).

comment "singularity-ce needs a toolchain w/ threads, wchar, dynamic library"
	depends on !BR2_TOOLCHAIN_HAS_THREADS || !BR2_USE_WCHAR || BR2_STATIC_LIBS
```
